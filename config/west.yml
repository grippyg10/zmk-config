## config/west.yml
```yaml
manifest:
  defaults:
    revision: v0.3
  remotes:
    - name: zmkfirmware
      url-base: https://github.com/zmkfirmware
    # Additional modules containing boards/shields/custom code can be listed here as well
    # See https://docs.zephyrproject.org/3.2.0/develop/west/manifest.html#projects
  projects:
    - name: zmk
      remote: zmkfirmware
      import: app/west.yml
    - name: charybdis-wireless-mini-zmk-firmware
      url: https://github.com/280Zo/charybdis-wireless-mini-zmk-firmware.git
      revision: main
      path: modules/charybdis-wireless-mini-zmk-firmware
    - name: charybdis_zmk
      url: https://github.com/nophramel/charybdis_zmk.git
      revision: main
      path: modules/charybdis_zmk
  self:
    path: config
```
